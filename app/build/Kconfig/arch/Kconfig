## app/build/Kconfig/arch/Kconfig
```kconfig
# Load Zephyr Arch Kconfig descriptions.
osource "/home/jaga/zephyrproject/zephyr/arch/rx/Kconfig"
osource "/home/jaga/zephyrproject/zephyr/arch/x86/Kconfig"
osource "/home/jaga/zephyrproject/zephyr/arch/xtensa/Kconfig"
osource "/home/jaga/zephyrproject/zephyr/arch/sparc/Kconfig"
osource "/home/jaga/zephyrproject/zephyr/arch/riscv/Kconfig"
osource "/home/jaga/zephyrproject/zephyr/arch/posix/Kconfig"
osource "/home/jaga/zephyrproject/zephyr/arch/mips/Kconfig"
osource "/home/jaga/zephyrproject/zephyr/arch/arm64/Kconfig"
osource "/home/jaga/zephyrproject/zephyr/arch/arm/Kconfig"
osource "/home/jaga/zephyrproject/zephyr/arch/arc/Kconfig"
```

## app/build/Kconfig/boards/Kconfig
```kconfig
# Load Zephyr board Kconfig descriptions.
osource "/home/jaga/zephyrproject/zephyr/boards/witte/linum/Kconfig"
```

## app/build/Kconfig/boards/Kconfig.defconfig
```kconfig
# Load Zephyr board defconfig descriptions.
osource "/home/jaga/zephyrproject/zephyr/boards/witte/linum/Kconfig.defconfig"
```

## app/build/Kconfig/boards/Kconfig.linum
```kconfig
# Load board Kconfig descriptions.
osource "/home/jaga/zephyrproject/zephyr/boards/witte/linum/Kconfig.linum"
```
